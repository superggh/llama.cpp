## examples/llama.android/esp32-firmware/sdkconfig.defaults
```kconfig
CONFIG_IDF_TARGET="esp32s3"

# Bluetooth NimBLE
CONFIG_BT_ENABLED=y
CONFIG_BT_NIMBLE_ENABLED=y
CONFIG_BT_NIMBLE_MEM_ALLOC_MODE_INTERNAL=y
CONFIG_BT_NIMBLE_MAX_CONNECTIONS=1
CONFIG_BT_NIMBLE_MAX_BONDS=0
CONFIG_BT_NIMBLE_MAX_CCCDS=1
CONFIG_BT_NIMBLE_L2CAP_COC_MAX_NUM=0
CONFIG_BT_NIMBLE_RPA_TIMEOUT=900
CONFIG_BT_NIMBLE_LOG_LEVEL_WARNING=y
CONFIG_BT_NIMBLE_LOG_LEVEL=2
CONFIG_BT_NIMBLE_HCI_EVT_BUF_SIZE=70

# PSRAM
CONFIG_SPIRAM=y
CONFIG_SPIRAM_MODE_OCT=y

# FreeRTOS
CONFIG_FREERTOS_UNICORE=n
CONFIG_FREERTOS_HZ=1000

# Main task
CONFIG_MAIN_TASK_STACK_SIZE=8192
```
